## main/Kconfig.projbuild
```kconfig
menu "Radio Configuration"

    config I2C_MASTER_SCL
        int "SCL GPIO Num"
        default 21
        help
            GPIO number for I2C Master clock line.

    config I2C_MASTER_SDA
        int "SDA GPIO Num"
        default 22
        help
            GPIO number for I2C Master data line.

    config I2C_MASTER_PORT_NUM
        int "Port Number"
        default 0
        help
            Port number for I2C Master device.

    config I2C_MASTER_FREQUENCY
        int "Master Frequency"
        default 400000
        help
            I2C Speed of Master device.

    config ESP_MAXIMUM_RETRY
        int "Maximum retry"
        default 255
        help
            Set the Maximum retry to avoid station reconnecting to the AP unlimited when the AP is really inexistent.

endmenu
```
